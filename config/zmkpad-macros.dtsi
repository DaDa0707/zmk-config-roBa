// Generated by ZMKPad. Edit macros in the iPad app.
/ {
    macros {
        zp_7936271ea1214cba8a229517ddba60b1: zp_7936271ea1214cba8a229517ddba60b1 {
            compatible = "zmk,behavior-macro";
            #binding-cells = <0>;
            label = "COPY_PASTE";
            tap-ms = <40>;
            wait-ms = <40>;
            bindings = <&macro_tap>, <&kp 0x08070006>, <&macro_wait_time 250>, <&kp 0x08070019>;
        };
    };
};
